## drivers/input/touchscreen/xiaomi/Kconfig
```kconfig
source "drivers/input/touchscreen/xiaomi/nt36672c/Kconfig"

config SECURE_TOUCH
	bool "Secure Touch"

config I2C_BY_DMA
	bool "I2C BY DMA"

config SPI_XIAOMI_TP
	bool
	depends on SPI
	default y if TOUCHSCREEN_NT36xxx_HOSTDL_SPI
	help
		Say Y if want use xiaomi touch panel.
```

## drivers/platform/xiaomi/Kconfig
```kconfig
# Xiaomi configuration options

config MACH_XIAOMI
	bool "Xiaomi device"
	depends on ARCH_QCOM
	help
	  Support for Xiaomi products

config MACH_XIAOMI_SM8150
	bool "Xiaomi SM8150"
	depends on ARCH_QCOM
	select MACH_XIAOMI
	help
	  Support for Xiaomi SM8150 devices

menu "Xiaomi board selection"

config MACH_XIAOMI_VAYU
	bool "Xiaomi vayu board"
	select MACH_XIAOMI_SM8150
	help
		Support for POCO X3 Pro

endmenu
```

## techpack/audio/asoc/codecs/Kconfig
```kconfig
menu "Qualcomm ASoC additional codecs"

source "techpack/audio/asoc/codecs/tas256x/Kconfig"

endmenu
```
